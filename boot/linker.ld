/* 
 * Morphic OS UEFI Linker Script
 * Target: x86_64-unknown-windows-msvc-coff (UEFI uses PE32+)
 */

OUTPUT_FORMAT("pei-x86-64")
ENTRY(EfiMain)

SECTIONS
{
    /* UEFI images begin at 0. The firmware relocates us. */
    . = 0;

    .image_header : 
    {
        /* Reserved for PE Header generated by the linker/objcopy */
    }

    /* Code Section */
    .text : ALIGN(4096)
    {
        *(.text)
        *(.text.*)
    }

    /* Read-only Data Section */
    .rdata : ALIGN(4096)
    {
        *(.rdata)
        *(.rdata.*)
        *(.rodata)
        *(.rodata.*)
    }

    /* Read-write Data Section */
    .data : ALIGN(4096)
    {
        *(.data)
        *(.data.*)
        *(.bss)
        *(.bss.*)
        *(COMMON)
    }

    /* Relocation Section - Critical for UEFI as we are relocatable */
    .reloc : ALIGN(4096)
    {
        *(.reloc)
    }

    /* Discard unnecessary sections */
    /DISCARD/ :
    {
        *(.comment)
        *(.eh_frame)
        *(.note.GNU-stack)
    }
}
